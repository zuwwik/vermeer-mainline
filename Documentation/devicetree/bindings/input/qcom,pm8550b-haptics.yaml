## Documentation/devicetree/bindings/input/qcom,pm8550b-haptics.yaml
```yaml
# SPDX-License-Identifier: GPL-2.0-only OR BSD-2-Clause
%YAML 1.2
---
$id: http://devicetree.org/schemas/input/qcom,pm8550b-haptics.yaml#
$schema: http://devicetree.org/meta-schemas/core.yaml#

title: Qualcomm PM8550B HAP525 High Voltage Haptics

maintainers:
  - Fenglin Wu <fenglin.wu@oss.qualcomm.com>

description: |
  PM8550B contains a HAP525_HV engine for linear resonant actuators. The
  configuration, pattern/FIFO and boost peripherals share the PMIC regmap.
  XBL supplies actuator resonance and closed-loop brake calibration. FIFO
  waveforms can use resonance-relative rates or fixed PCM sample rates.

properties:
  compatible:
    const: qcom,pm8550b-haptics

  reg:
    items:
      - description: Haptics configuration peripheral
      - description: Pattern and FIFO peripheral
      - description: Haptics boost peripheral

  reg-names:
    items:
      - const: cfg
      - const: ptn
      - const: boost

  interrupts:
    maxItems: 1

  interrupt-names:
    const: fifo-empty

  qcom,vmax-microvolt:
    description: Continuous actuator drive voltage, from the board specification.
    minimum: 50000
    maximum: 10000000
    multipleOf: 50000

  qcom,custom-vmax-microvolt:
    description: |
      Maximum voltage allowed for custom transient waveforms. Defaults to
      qcom,vmax-microvolt. A larger value requires board-specific transient
      actuator qualification.
    minimum: 50000
    maximum: 10000000
    multipleOf: 50000

  qcom,lra-period-us:
    description: Nominal actuator resonance period, used if XBL calibration is invalid.
    minimum: 5
    maximum: 20475
    multipleOf: 5

required:
  - compatible
  - reg
  - reg-names
  - interrupts
  - interrupt-names
  - qcom,vmax-microvolt
  - qcom,lra-period-us

additionalProperties: false
```

## Documentation/devicetree/bindings/media/i2c/ovti,ov16a1q.yaml
```yaml
# SPDX-License-Identifier: (GPL-2.0-only OR BSD-2-Clause)
%YAML 1.2
---
$id: http://devicetree.org/schemas/media/i2c/ovti,ov16a1q.yaml#
$schema: http://devicetree.org/meta-schemas/core.yaml#

title: OmniVision OV16A1Q image sensor

maintainers:
  - azio7 <azio7@outlook.com>

description:
  Sixteen megapixel Bayer sensor with an I2C control interface and four MIPI
  CSI-2 D-PHY data lanes. This driver supports the 19.2 MHz input clock mode.

allOf:
  - $ref: /schemas/media/video-interface-devices.yaml#

properties:
  compatible:
    const: ovti,ov16a1q

  reg:
    maxItems: 1

  clocks:
    maxItems: 1

  reset-gpios:
    description: Active-low RESETB input.
    maxItems: 1

  avdd-supply:
    description: Analog power supply.

  dvdd-supply:
    description: Digital core power supply.

  dovdd-supply:
    description: Digital I/O power supply.

  port:
    $ref: /schemas/graph.yaml#/$defs/port-base
    additionalProperties: false

    properties:
      endpoint:
        $ref: /schemas/media/video-interfaces.yaml#
        unevaluatedProperties: false

        properties:
          data-lanes:
            items:
              - const: 1
              - const: 2
              - const: 3
              - const: 4

          link-frequencies:
            items:
              - const: 696000000

        required:
          - data-lanes
          - link-frequencies

    required:
      - endpoint

required:
  - compatible
  - reg
  - clocks
  - reset-gpios
  - avdd-supply
  - dvdd-supply
  - dovdd-supply
  - port

unevaluatedProperties: false

examples:
  - |
    #include <dt-bindings/gpio/gpio.h>

    i2c {
        #address-cells = <1>;
        #size-cells = <0>;

        camera@10 {
            compatible = "ovti,ov16a1q";
            reg = <0x10>;
            clocks = <&camera_clk>;
            reset-gpios = <&gpio 120 GPIO_ACTIVE_LOW>;
            avdd-supply = <&camera_avdd>;
            dvdd-supply = <&camera_dvdd>;
            dovdd-supply = <&camera_dovdd>;

            port {
                endpoint {
                    data-lanes = <1 2 3 4>;
                    link-frequencies = /bits/ 64 <696000000>;
                    remote-endpoint = <&csi_in>;
                };
            };
        };
    };
```

## Documentation/devicetree/bindings/media/i2c/ovti,ovx8000.yaml
```yaml
# SPDX-License-Identifier: (GPL-2.0-only OR BSD-2-Clause)
%YAML 1.2
---
$id: http://devicetree.org/schemas/media/i2c/ovti,ovx8000.yaml#
$schema: http://devicetree.org/meta-schemas/core.yaml#

title: OmniVision OVX8000 image sensor

maintainers:
  - azio7 <azio7@outlook.com>

description:
  Fifty megapixel sensor used by the Xiaomi Vermeer main camera module.
  The supported modes output binned RAW10 over three MIPI CSI-2 C-PHY trios
  with a 19.2 MHz external clock. The focus actuator is a separate device.

allOf:
  - $ref: /schemas/media/video-interface-devices.yaml#

properties:
  compatible:
    const: ovti,ovx8000

  reg:
    maxItems: 1

  clocks:
    maxItems: 1

  reset-gpios:
    maxItems: 1
    description: Active-low sensor reset input.

  avdd-supply:
    description: Analog supply, 2.8 V.

  dvdd-supply:
    description: Digital core supply, 1.104 V on Vermeer.

  dovdd-supply:
    description: Digital I/O supply, 1.8 V.

  afvdd-supply:
    description: Module actuator supply, shared with the focus driver.

  lens-focus: true

  port:
    $ref: /schemas/graph.yaml#/$defs/port-base
    additionalProperties: false

    properties:
      endpoint:
        $ref: /schemas/media/video-interfaces.yaml#
        unevaluatedProperties: false

        properties:
          bus-type:
            const: 1

          data-lanes:
            items:
              - const: 0
              - const: 1
              - const: 2

          link-frequencies:
            items:
              - const: 1348800000

        required:
          - bus-type
          - data-lanes
          - link-frequencies

    required:
      - endpoint

required:
  - compatible
  - reg
  - clocks
  - reset-gpios
  - avdd-supply
  - dvdd-supply
  - dovdd-supply
  - afvdd-supply
  - port

unevaluatedProperties: false

examples:
  - |
    #include <dt-bindings/gpio/gpio.h>

    i2c {
        #address-cells = <1>;
        #size-cells = <0>;

        camera@10 {
            compatible = "ovti,ovx8000";
            reg = <0x10>;
            clocks = <&camera_clk>;
            reset-gpios = <&gpio 118 GPIO_ACTIVE_LOW>;
            avdd-supply = <&camera_avdd>;
            dvdd-supply = <&camera_dvdd>;
            dovdd-supply = <&camera_dovdd>;
            afvdd-supply = <&camera_afvdd>;

            port {
                endpoint {
                    bus-type = <1>;
                    data-lanes = <0 1 2>;
                    link-frequencies = /bits/ 64 <1348800000>;
                };
            };
        };
    };
```

## Documentation/devicetree/bindings/misc/xiaomi,vermeer-fingerprint.yaml
```yaml
# SPDX-License-Identifier: (GPL-2.0-only OR BSD-2-Clause)
%YAML 1.2
---
$id: http://devicetree.org/schemas/misc/xiaomi,vermeer-fingerprint.yaml#
$schema: http://devicetree.org/meta-schemas/core.yaml#

title: Xiaomi Vermeer Goodix optical fingerprint sensor

maintainers:
  - zuwwik <zuwwiks@gmail.com>

description: |
  The sensor's SPI bus belongs to the secure world. Linux manages only
  its supply, active-low reset and interrupt. The paired trusted application
  performs capture and matching. This binding identifies the board assembly;
  the exact Goodix part number is not exposed by the stock device tree.

properties:
  compatible:
    const: xiaomi,vermeer-fingerprint

  vdd-supply: true

  reset-gpios:
    maxItems: 1

  interrupts:
    maxItems: 1

  firmware-name:
    description: Name of the paired trusted application, without an extension.
    const: gfvermeer

  wakeup-source: true

required:
  - compatible
  - vdd-supply
  - reset-gpios
  - interrupts
  - firmware-name

additionalProperties: false
```

## Documentation/devicetree/bindings/regulator/willsemi,wl2868c.yaml
```yaml
# SPDX-License-Identifier: (GPL-2.0-only OR BSD-2-Clause)
%YAML 1.2
---
$id: http://devicetree.org/schemas/regulator/willsemi,wl2868c.yaml#
$schema: http://devicetree.org/meta-schemas/core.yaml#

title: Will Semiconductor WL2868C camera power management IC

maintainers:
  - Mark Brown <broonie@kernel.org>

description:
  Seven I2C-controlled LDOs, with two digital supplies adjustable from
  0.496 V to 1.512 V and five analog supplies from 1.504 V to 3.544 V.

properties:
  compatible:
    const: willsemi,wl2868c

  reg:
    maxItems: 1

  reset-gpios:
    description: Active-low RST_N input. Keep deasserted while outputs are used.
    maxItems: 1

  vin12-supply:
    description: Input supply for LDO1 and LDO2.

  vin34-supply:
    description: Input supply for LDO3 and LDO4.

  vin5-supply:
    description: Input supply for LDO5.

  vin6-supply:
    description: Input supply for LDO6.

  vin7-supply:
    description: Input supply for LDO7.

  regulators:
    type: object
    additionalProperties: false

    patternProperties:
      "^ldo[1-7]$":
        $ref: regulator.yaml#
        type: object
        unevaluatedProperties: false

required:
  - compatible
  - reg
  - regulators

additionalProperties: false

examples:
  - |
    #include <dt-bindings/gpio/gpio.h>

    i2c {
        #address-cells = <1>;
        #size-cells = <0>;

        pmic@2f {
            compatible = "willsemi,wl2868c";
            reg = <0x2f>;
            reset-gpios = <&gpio 126 GPIO_ACTIVE_LOW>;

            regulators {
                ldo2 {
                    regulator-name = "camera-dvdd";
                    regulator-min-microvolt = <1200000>;
                    regulator-max-microvolt = <1200000>;
                };
            };
        };
    };
```
